## CMakeLists.txt
```
#
#    Copyright (c) 2022 Project CHIP Authors
#
#    Licensed under the Apache License, Version 2.0 (the "License");
#    you may not use this file except in compliance with the License.
#    You may obtain a copy of the License at
#
#        http://www.apache.org/licenses/LICENSE-2.0
#
#    Unless required by applicable law or agreed to in writing, software
#    distributed under the License is distributed on an "AS IS" BASIS,
#    WITHOUT WARRANTIES OR CONDITIONS OF ANY KIND, either express or implied.
#    See the License for the specific language governing permissions and
#    limitations under the License.
#
cmake_minimum_required(VERSION 3.13.1)

get_filename_component(CHIP_ROOT ${CMAKE_CURRENT_SOURCE_DIR}/third_party/connectedhomeip REALPATH)
get_filename_component(TELINK_COMMON ${CHIP_ROOT}/examples/platform/telink REALPATH)
get_filename_component(GEN_DIR ${CHIP_ROOT}/zzz_generated/ REALPATH)

set(ignoreMe "${TLNK_USB_DONGLE}")

if(${TLNK_MARS_BOARD} MATCHES y)
  if(EXISTS "${CHIP_ROOT}/src/platform/telink/${BOARD}_mars.overlay")
    set(MARS_DTC_OVERLAY_FILE "${CHIP_ROOT}/src/platform/telink/${BOARD}_mars.overlay")
  else()
    unset(MARS_DTC_OVERLAY_FILE)
  endif()
  if(EXISTS "${CHIP_ROOT}/src/platform/telink/${BOARD}_mars.conf")
    set(MARS_CONF_OVERLAY_FILE "${CHIP_ROOT}/src/platform/telink/${BOARD}_mars.conf")
  else()
    unset(MARS_CONF_OVERLAY_FILE)
  endif()
else()
  unset(MARS_CONF_OVERLAY_FILE)
endif()

if(${TLNK_USB_DONGLE} MATCHES y)
  if(EXISTS "${CHIP_ROOT}/src/platform/telink/${BOARD}_usb.overlay")
    set(USB_DTC_OVERLAY_FILE "${CHIP_ROOT}/src/platform/telink/${BOARD}_usb.overlay")
  else()
    unset(USB_DTC_OVERLAY_FILE)
  endif()
  if(EXISTS "${CHIP_ROOT}/src/platform/telink/${BOARD}_usb.conf")
    set(USB_CONF_OVERLAY_FILE "${CHIP_ROOT}/src/platform/telink/${BOARD}_usb.conf")
  else()
    unset(USB_CONF_OVERLAY_FILE)
  endif()
else()
  unset(USB_CONF_OVERLAY_FILE)
endif()

if(EXISTS "${CMAKE_CURRENT_SOURCE_DIR}/boards/${BOARD}.overlay")
  set(LOCAL_DTC_OVERLAY_FILE "${CMAKE_CURRENT_SOURCE_DIR}/boards/${BOARD}.overlay")
else()
  unset(LOCAL_DTC_OVERLAY_FILE)
endif()

if(EXISTS "${CHIP_ROOT}/src/platform/telink/${BOARD}.overlay")
  set(GLOBAL_DTC_OVERLAY_FILE "${CHIP_ROOT}/src/platform/telink/${BOARD}.overlay")
else()
  unset(GLOBAL_DTC_OVERLAY_FILE)
endif()

if(EXISTS "${CHIP_ROOT}/src/platform/telink/${FLASH_SIZE}_flash.overlay")
  set(FLASH_DTC_OVERLAY_FILE "${CHIP_ROOT}/src/platform/telink/${FLASH_SIZE}_flash.overlay")
  message(STATUS "Flash memory size is set to: " ${FLASH_SIZE} "b")
else()
  set(FLASH_DTC_OVERLAY_FILE "${CHIP_ROOT}/src/platform/telink/2m_flash.overlay")
  message(STATUS "Flash memory size is set to: 2mb")
endif()

if(DTC_OVERLAY_FILE)
  set(DTC_OVERLAY_FILE
    "${DTC_OVERLAY_FILE} ${GLOBAL_DTC_OVERLAY_FILE} ${USB_DTC_OVERLAY_FILE} ${MARS_DTC_OVERLAY_FILE} ${FLASH_DTC_OVERLAY_FILE} ${LOCAL_DTC_OVERLAY_FILE}"
    CACHE STRING "" FORCE
  )
else()
  set(DTC_OVERLAY_FILE ${GLOBAL_DTC_OVERLAY_FILE} ${USB_DTC_OVERLAY_FILE} ${MARS_DTC_OVERLAY_FILE} ${FLASH_DTC_OVERLAY_FILE} ${LOCAL_DTC_OVERLAY_FILE})
endif()

set(CONF_FILE ${USB_CONF_OVERLAY_FILE} ${MARS_CONF_OVERLAY_FILE} prj.conf)

# Load NCS/Zephyr build system
list(APPEND ZEPHYR_EXTRA_MODULES ${CHIP_ROOT}/config/telink/chip-module)
find_package(Zephyr HINTS $ENV{ZEPHYR_BASE})

project(chip-telink-lighting-example)

include(${CHIP_ROOT}/config/telink/app/enable-gnu-std.cmake)
include(${CHIP_ROOT}/src/app/chip_data_model.cmake)

target_compile_options(app PRIVATE -fpermissive)

target_include_directories(app PRIVATE
                           include
                           ${GEN_DIR}/app-common
                           ${GEN_DIR}/lighting-app
                           ${TELINK_COMMON}/common/include
                           ${TELINK_COMMON}/user/include
                           ${TELINK_COMMON}/util/include
                           ${TELINK_COMMON}/app/include)

add_definitions(
    "-DCHIP_ADDRESS_RESOLVE_IMPL_INCLUDE_HEADER=<lib/address_resolve/AddressResolve_DefaultImpl.h>"
)

target_sources(app PRIVATE
               src/AppTask.cpp
               src/ZclCallbacks.cpp
               src/DeviceDimmer.cpp
               ${TELINK_COMMON}/common/src/mainCommon.cpp
               ${TELINK_COMMON}/common/src/AppTaskCommon.cpp
               ${TELINK_COMMON}/user/src/UartService.cpp
               ${TELINK_COMMON}/user/src/protocol_define.cpp
               ${TELINK_COMMON}/user/src/mcu_api.cpp
               ${TELINK_COMMON}/user/src/system_define.cpp
               ${TELINK_COMMON}/user/src/user_service.cpp
               ${TELINK_COMMON}/util/src/LEDWidget.cpp
               ${TELINK_COMMON}/util/src/ButtonManager.cpp
               ${TELINK_COMMON}/util/src/ThreadUtil.cpp
               ${TELINK_COMMON}/util/src/PWMDevice.cpp
               ${TELINK_COMMON}/util/src/WS2812Device.cpp
               ${TELINK_COMMON}/util/src/ColorFormat.cpp)

chip_configure_data_model(app
    INCLUDE_SERVER
    ZAP_FILE ${CMAKE_CURRENT_SOURCE_DIR}/../lighting-common/lighting-app.zap
)

# Fix for unused swap parameter in: zephyr/include/zephyr/arch/riscv/irq.h:70
add_compile_options(-Wno-error=unused-parameter)

if (CONFIG_CHIP_PW_RPC)

# Make all targets created below depend on zephyr_interface to inherit MCU-related compilation flags
link_libraries($<BUILD_INTERFACE:zephyr_interface>)

set(PIGWEED_ROOT "${CHIP_ROOT}/third_party/pigweed/repo")
include(${PIGWEED_ROOT}/pw_build/pigweed.cmake)
include(${PIGWEED_ROOT}/pw_protobuf_compiler/proto.cmake)

include($ENV{PW_ROOT}/pw_assert/backend.cmake)
include($ENV{PW_ROOT}/pw_log/backend.cmake)
include($ENV{PW_ROOT}/pw_sys_io/backend.cmake)

pw_set_module_config(pw_rpc_CONFIG pw_rpc.disable_global_mutex_config)
pw_set_backend(pw_log pw_log_basic)
pw_set_backend(pw_assert.check pw_assert_log.check_backend)
pw_set_backend(pw_assert.assert pw_assert.assert_compatibility_backend)
pw_set_backend(pw_sys_io pw_sys_io.telink)

set(dir_pw_third_party_nanopb "${CHIP_ROOT}/third_party/nanopb/repo" CACHE STRING "" FORCE)

add_subdirectory(third_party/connectedhomeip/third_party/pigweed/repo)
add_subdirectory(third_party/connectedhomeip/third_party/nanopb/repo)
add_subdirectory(third_party/connectedhomeip/examples/platform/telink/pw_sys_io)

pw_proto_library(attributes_service
  SOURCES
    ${CHIP_ROOT}/examples/common/pigweed/protos/attributes_service.proto
  INPUTS
    ${CHIP_ROOT}/examples/common/pigweed/protos/attributes_service.options
  PREFIX
    attributes_service
  STRIP_PREFIX
    ${CHIP_ROOT}/examples/common/pigweed/protos
  DEPS
    pw_protobuf.common_proto
)

pw_proto_library(button_service
  SOURCES
    ${CHIP_ROOT}/examples/common/pigweed/protos/button_service.proto
  PREFIX
    button_service
  STRIP_PREFIX
    ${CHIP_ROOT}/examples/common/pigweed/protos
  DEPS
    pw_protobuf.common_proto
)

pw_proto_library(descriptor_service
  SOURCES
    ${CHIP_ROOT}/examples/common/pigweed/protos/descriptor_service.proto
  PREFIX
    descriptor_service
  STRIP_PREFIX
    ${CHIP_ROOT}/examples/common/pigweed/protos
  DEPS
    pw_protobuf.common_proto
)

pw_proto_library(device_service
  SOURCES
    ${CHIP_ROOT}/examples/common/pigweed/protos/device_service.proto
  INPUTS
    ${CHIP_ROOT}/examples/common/pigweed/protos/device_service.options
  PREFIX
    device_service
  STRIP_PREFIX
    ${CHIP_ROOT}/examples/common/pigweed/protos
  DEPS
    pw_protobuf.common_proto
)

pw_proto_library(lighting_service
  SOURCES
    ${CHIP_ROOT}/examples/common/pigweed/protos/lighting_service.proto
  STRIP_PREFIX
    ${CHIP_ROOT}/examples/common/pigweed/protos
  PREFIX
    lighting_service
  DEPS
    pw_protobuf.common_proto
)

pw_proto_library(ot_cli_service
  SOURCES
    ${CHIP_ROOT}/examples/common/pigweed/protos/ot_cli_service.proto
  INPUTS
    ${CHIP_ROOT}/examples/common/pigweed/protos/ot_cli_service.options
  STRIP_PREFIX
    ${CHIP_ROOT}/examples/common/pigweed/protos
  PREFIX
    ot_cli_service
  DEPS
    pw_protobuf.common_proto
)

pw_proto_library(thread_service
  SOURCES
    ${CHIP_ROOT}/examples/common/pigweed/protos/thread_service.proto
  INPUTS
    ${CHIP_ROOT}/examples/common/pigweed/protos/thread_service.options
  STRIP_PREFIX
    ${CHIP_ROOT}/examples/common/pigweed/protos
  PREFIX
    thread_service
  DEPS
    pw_protobuf.common_proto
)

target_sources(app PRIVATE
  ../../common/pigweed/RpcService.cpp
  ../../common/pigweed/telink/PigweedLoggerMutex.cpp
  ${TELINK_COMMON}/Rpc.cpp
  ${TELINK_COMMON}/util/src/PigweedLogger.cpp
)

target_include_directories(app PRIVATE
  ${PIGWEED_ROOT}/pw_sys_io/public
  ${CHIP_ROOT}/src/lib/support
  ${CHIP_ROOT}/src/system
  ${TELINK_COMMON}
  ../../common
  ../../common/pigweed
  ../../common/pigweed/telink)

target_compile_options(app PRIVATE
                       "-DPW_RPC_ATTRIBUTE_SERVICE=1"
                       "-DPW_RPC_BUTTON_SERVICE=1"
                       "-DPW_RPC_DESCRIPTOR_SERVICE=1"
                       "-DPW_RPC_DEVICE_SERVICE=1"
                       "-DPW_RPC_LIGHTING_SERVICE=1"
                       "-DPW_RPC_THREAD_SERVICE=1")

target_link_libraries(app PRIVATE
  attributes_service.nanopb_rpc
  button_service.nanopb_rpc
  descriptor_service.nanopb_rpc
  device_service.nanopb_rpc
  lighting_service.nanopb_rpc
  thread_service.nanopb_rpc
  pw_checksum
  pw_hdlc
  pw_hdlc.pw_rpc
  pw_log
  pw_rpc.server
  pw_sys_io
)

endif(CONFIG_CHIP_PW_RPC)
```

## prj.conf
```kconfig
#
#    Copyright (c) 2021-2023 Project CHIP Authors
#
#    Licensed under the Apache License, Version 2.0 (the "License");
#    you may not use this file except in compliance with the License.
#    You may obtain a copy of the License at
#
#        http://www.apache.org/licenses/LICENSE-2.0
#
#    Unless required by applicable law or agreed to in writing, software
#    distributed under the License is distributed on an "AS IS" BASIS,
#    WITHOUT WARRANTIES OR CONDITIONS OF ANY KIND, either express or implied.
#    See the License for the specific language governing permissions and
#    limitations under the License.
#

# This sample uses sample-defaults.conf to set options common for all
# samples. This file should contain only options specific for this sample
# or overrides of default values.

# Enable CHIP
CONFIG_CHIP=y
CONFIG_STD_CPP17=y
CONFIG_SERIAL=y
CONFIG_UART_INTERRUPT_DRIVEN=y
# CONFIG_UART_USE_ASYNC_API=y

# CHIP configuration
CONFIG_CHIP_PROJECT_CONFIG="include/CHIPProjectConfig.h"
CONFIG_CHIP_OPENTHREAD_CONFIG="../../platform/telink/project_include/OpenThreadConfig.h"

# 32773 == 0x8005 (example lighting-app)
CONFIG_CHIP_DEVICE_PRODUCT_ID=32773


# Bluetooth Low Energy configuration
CONFIG_BT_DEVICE_NAME="Freelux Light"

# Disable Matter OTA DFU
CONFIG_CHIP_OTA_REQUESTOR=n
CONFIG_CHIP_DEVICE_SOFTWARE_VERSION=1

# Enable CHIP pairing automatically on application start.
CONFIG_CHIP_ENABLE_PAIRING_AUTOSTART=y

# Disable CHIP shell support
CONFIG_CHIP_LIB_SHELL=n

# Disable factory data support
CONFIG_CHIP_FACTORY_DATA=n
CONFIG_CHIP_FACTORY_DATA_BUILD=n
CONFIG_CHIP_FACTORY_DATA_MERGE_WITH_FIRMWARE=n
CONFIG_CHIP_CERTIFICATION_DECLARATION_STORAGE=n

# Enable Power Management
CONFIG_PM=n
```

## include/AppTask.h
```c
/*
 *
 *    Copyright (c) 2022-2023 Project CHIP Authors
 *    All rights reserved.
 *
 *    Licensed under the Apache License, Version 2.0 (the "License");
 *    you may not use this file except in compliance with the License.
 *    You may obtain a copy of the License at
 *
 *        http://www.apache.org/licenses/LICENSE-2.0
 *
 *    Unless required by applicable law or agreed to in writing, software
 *    distributed under the License is distributed on an "AS IS" BASIS,
 *    WITHOUT WARRANTIES OR CONDITIONS OF ANY KIND, either express or implied.
 *    See the License for the specific language governing permissions and
 *    limitations under the License.
 */

#pragma once

#include "AppTaskCommon.h"
#include "DeviceDimmer.h"
#include "fl.h"

struct CheckACK
{
    uint8_t dp_id;
    bool check;
};

class AppTask : public AppTaskCommon
{
public:
    DeviceDimmer & GetDimmerDevice(void) { return mDimmerDevice; }
    void SetInitiateAction(DeviceDimmer::Action_t aAction, int32_t aActor, uint8_t * value);
    void SetNetworkState(uint8_t state);
    uint8_t GetNetworkState(void) { return networkState; }
    void ControlCMD(fl_data_t data);
    uint8_t UpdateDevice(uint8_t dpid,const uint8_t value[], unsigned short length);
    unsigned char HandleBrightValue(char channel, const unsigned char value[], unsigned short length);
    // unsigned char HandleMinBrightValue(char channel, const unsigned char value[], unsigned short length);
    // unsigned char HandleMaxBrightValue(char channel, const unsigned char value[], unsigned short length);
    unsigned char HandleOnOffValue(char channel, const unsigned char value[], unsigned short length);
    unsigned char HandleHSL(char channel, const unsigned char value[], unsigned short length);
    void UpdateClusterState(void);
    void HandleUartCallback(void);
    void UpdateNumberDevice(void);
    void ReportNetworkState(void);
private:
    friend AppTask & GetAppTask(void);
    friend class AppTaskCommon;
    CHIP_ERROR Init(void);
    static void ActionInitiated(DeviceDimmer::Action_t aAction, int32_t aActor);
    static void ActionCompleted(DeviceDimmer::Action_t aAction, int32_t aActor);
    static void LightingActionEventHandler(AppEvent * aEvent);

    DeviceDimmer mDimmerDevice;
    
    uint8_t networkState;

    static AppTask sAppTask;
};

inline AppTask & GetAppTask(void)
{
    return AppTask::sAppTask;
}
```

## include/DeviceDimmer.h
```c
/*
 *
 *    Copyright (c) 2023 Project CHIP Authors
 *
 *    Licensed under the Apache License, Version 2.0 (the "License");
 *    you may not use this file except in compliance with the License.
 *    You may obtain a copy of the License at
 *
 *        http://www.apache.org/licenses/LICENSE-2.0
 *
 *    Unless required by applicable law or agreed to in writing, software
 *    distributed under the License is distributed on an "AS IS" BASIS,
 *    WITHOUT WARRANTIES OR CONDITIONS OF ANY KIND, either express or implied.
 *    See the License for the specific language governing permissions and
 *    limitations under the License.
 */
#pragma once

#include <app/util/attribute-storage.h>

#include <functional>
#include <stdbool.h>
#include <system/SystemError.h>
#include <zephyr/drivers/gpio.h>
#include <zephyr/drivers/pwm.h>
#include "ColorFormat.h"


#include <cstdint>

#include <stdint.h>

enum TypeLight_t : uint8_t
{
    kTypeLight_OnOff = 0,
    kTypeLight_LevelControl,
    kTypeLight_ColorControl,
    kTypeLight_ColorTemperature,
    kTypeLight_Invalid
};

struct HSLColor_t
{
    uint16_t hue;
    uint16_t saturation;
    uint16_t level;
};
struct CCTColor_t
{
    uint16_t colorTemperature;
    uint16_t level;
};

class DeviceDimmer
{
public:
    static const int kDeviceNameSize     = 32;
    static const int kDeviceLocationSize = 32;

    enum Action_t : uint8_t
    {
        ON_ACTION = 0,
        OFF_ACTION,
        LEVEL_ACTION,
        MIN_LEVEL_ACTION,
        MAX_LEVEL_ACTION,
        COLOR_ACTION_XY,
        COLOR_ACTION_HSV,
        COLOR_ACTION_CT,

        INVALID_ACTION
    };

    enum State_t : uint8_t
    {
        kState_On = 0,
        kState_Off,
        kUnknownState
    };

    enum BreatheType_t : uint8_t
    {
        kBreatheType_Invalid = 0,
        kBreatheType_Rising,
        kBreatheType_Falling,
        kBreatheType_Both,
    };
    const unsigned long MAX_BRIGHTNESS_COLOR = 0xffff;
    using DimmerCallback_fn      = void (*)(Action_t, int32_t);
    using DimmerTimerCallback_fn = void (*)(k_timer *);

    CHIP_ERROR Init(const char * szDeviceName, const char * szLocation, uint8_t level, uint8_t min, uint8_t max);
    void Set(bool aOn);
    bool IsTurnedOn(void) const { return mState == kState_On; }
    uint8_t GetLevel(void) const { return mLevel; }
    uint8_t GetMinLevel(void) const { return mMinLevel; }
    uint8_t GetMaxLevel(void) const { return mMaxLevel; }
    HsvColor_t GetHSVColor(void) const { return mHsvColor; }
    CCTColor_t GetCCTColor(void) const { return CCTColor_t(); }
    TypeLight_t GetType(void) const { return mType; }
    // void SetCallbacks(DimmerCallback_fn aActionInitiated_CB, DimmerCallback_fn aActionCompleted_CB,
    //                   DimmerTimerCallback_fn aActionBlinkStateUpdate_CB);
    bool InitiateAction(Action_t aAction, int32_t aActor, uint8_t * value);
    bool UpdateFromHardware(Action_t aAction, int32_t aActor, uint8_t * value);
    void StopAction(void);
    void UpdateAction(void);

private:
    TypeLight_t mType;
    State_t mState;
    uint8_t mMinLevel;
    uint8_t mMaxLevel;
    uint8_t mLevel;
    HsvColor_t mHsvColor;
    CCTColor_t mCCTColor;
    char mName[kDeviceNameSize];
    char mLocation[kDeviceLocationSize];

    DimmerCallback_fn mActionInitiatedClb;
    DimmerCallback_fn mActionCompletedClb;
    DimmerTimerCallback_fn mActionBlinkStateUpdateClb;

    void SetLevel(uint8_t level);
    void SetHSVColor(uint8_t hue, uint8_t saturation);
    void SetColorLevel(uint16_t level);
    void SetCCTColor(uint16_t colorTemperature);
    void UpdateLight(void);
    void ClearAction(void);

};
```

## src/AppTask.cpp
```c
/*
 *
 *    Copyright (c) 2022-2023 Project CHIP Authors
 *    All rights reserved.
 *
 *    Licensed under the Apache License, Version 2.0 (the "License");
 *    you may not use this file except in compliance with the License.
 *    You may obtain a copy of the License at
 *
 *        http://www.apache.org/licenses/LICENSE-2.0
 *
 *    Unless required by applicable law or agreed to in writing, software
 *    distributed under the License is distributed on an "AS IS" BASIS,
 *    WITHOUT WARRANTIES OR CONDITIONS OF ANY KIND, either express or implied.
 *    See the License for the specific language governing permissions and
 *    limitations under the License.
 */

#include "AppTask.h"
#include <app/server/Server.h>

#include "ColorFormat.h"
#include "DeviceDimmer.h"
#include "PWMDevice.h"
#include "libuser.h"
#include "string.h"
#include <app-common/zap-generated/attributes/Accessors.h>

LOG_MODULE_DECLARE(app, CONFIG_CHIP_APP_LOG_LEVEL);

namespace {
#ifdef CONFIG_WS2812_STRIP
const struct device * const ws2812_dev = DEVICE_DT_GET(DT_ALIAS(led_strip));
#else
// const struct pwm_dt_spec sPwmRgbSpecBlueLed  = PWM_DT_SPEC_GET(DT_ALIAS(pwm_led0));

#if USE_RGB_PWM
// const struct pwm_dt_spec sPwmRgbSpecGreenLed = PWM_DT_SPEC_GET(DT_ALIAS(pwm_led1));
// const struct pwm_dt_spec sPwmRgbSpecRedLed   = PWM_DT_SPEC_GET(DT_ALIAS(pwm_led2));
#endif
#endif // CONFIG_WS2812_STRIP




#if defined(CONFIG_WS2812_STRIP) || USE_RGB_PWM
uint8_t sBrightness;
PWMDevice::Action_t sColorAction = PWMDevice::INVALID_ACTION;
XyColor_t sXY;
HsvColor_t sHSV;
CtColor_t sCT;
#endif // CONFIG_WS2812_STRIP || USE_RGB_PWM
} // namespace

AppTask AppTask::sAppTask;

#ifdef CONFIG_CHIP_ENABLE_POWER_ON_FACTORY_RESET
void AppTask::PowerOnFactoryReset(void)
{
    LOG_INF("Lighting App Power On Factory Reset");
    AppEvent event;
    event.Type    = AppEvent::kEventType_Lighting;
    event.Handler = PowerOnFactoryResetEventHandler;
    GetAppTask().PostEvent(&event);
}
#endif /* CONFIG_CHIP_ENABLE_POWER_ON_FACTORY_RESET */

extern	k_msgq		queue_data_tx;
extern	k_msgq		queue_data_rx;


bool CheckACK = false;

extern DOWNLOAD_CMD_S download_cmd[];

void Control_cmd(fl_data_t data);

CHIP_ERROR AppTask::Init(void)
{
    CHIP_ERROR err;

    // Init lighting manager
    uint8_t minLightLevel = kDefaultMinLevel;
    Clusters::LevelControl::Attributes::MinLevel::Get(kExampleEndpointId, &minLightLevel);

    uint8_t maxLightLevel = kDefaultMaxLevel;
    Clusters::LevelControl::Attributes::MaxLevel::Get(kExampleEndpointId, &maxLightLevel);

#ifdef CONFIG_WS2812_STRIP
    err = sAppTask.mWS2812Device.Init(ws2812_dev, STRIP_NUM_PIXELS(led_strip));
    if (err != CHIP_NO_ERROR)
    {
        LOG_ERR("WS2812 Device Init fail");
        return err;
    }
#else
    // err = sAppTask.mPwmRgbBlueLed.Init(&sPwmRgbSpecBlueLed, minLightLevel, maxLightLevel, maxLightLevel);
    err = sAppTask.mDimmerDevice.Init("Dimmer", "Living Room", 0, minLightLevel, maxLightLevel);
    
    if (err != CHIP_NO_ERROR)
    {
        LOG_ERR("Dimmer Device Init fail");
        return err;
    }
#if USE_RGB_PWM
    err = sAppTask.mPwmRgbRedLed.Init(&sPwmRgbSpecRedLed, minLightLevel, maxLightLevel, maxLightLevel);
    if (err != CHIP_NO_ERROR)
    {
        LOG_ERR("Red RGB PWM Device Init fail");
        return err;
    }

    err = sAppTask.mPwmRgbGreenLed.Init(&sPwmRgbSpecGreenLed, minLightLevel, maxLightLevel, maxLightLevel);
    if (err != CHIP_NO_ERROR)
    {
        LOG_ERR("Green RGB PWM Device Init fail");
        return err;
    }
#endif

    // sAppTask.mDimmerDevice.SetCallbacks(ActionInitiated, ActionCompleted, nullptr);
    // sAppTask.mPwmRgbBlueLed.SetCallbacks(ActionInitiated, ActionCompleted, nullptr);
#endif // CONFIG_WS2812_STRIP

#if APP_USE_EXAMPLE_START_BUTTON
    // SetExampleButtonCallbacks(LightingActionEventHandler);
#endif
    InitCommonParts();

    return CHIP_NO_ERROR;
}

void AppTask::LightingActionEventHandler(AppEvent * aEvent)
{
#ifdef CONFIG_WS2812_STRIP
    if (aEvent->Type == AppEvent::kEventType_Button)
    {
        if (sAppTask.mWS2812Device.IsTurnedOn())
        {
            sAppTask.mWS2812Device.Set(SET_RGB_TURN_OFF);
        }
        else
        {
            sAppTask.mWS2812Device.Set(SET_RGB_TURN_ON);
        }

        sAppTask.UpdateClusterState();
    }
#else
    // PWMDevice::Action_t action = PWMDevice::INVALID_ACTION;
    // int32_t actor              = 0;
    DeviceDimmer::Action_t dimmerAction = DeviceDimmer::INVALID_ACTION;
    int32_t dimmerActor              = 0;

    if (aEvent->Type == AppEvent::kEventType_Lighting)
    {
        // action = static_cast<PWMDevice::Action_t>(aEvent->LightingEvent.Action);
        // actor  = aEvent->LightingEvent.Actor;
        dimmerAction = static_cast<DeviceDimmer::Action_t>(aEvent->LightingEvent.Action);
        dimmerActor  = aEvent->LightingEvent.Actor;
    }
    else if (aEvent->Type == AppEvent::kEventType_Button)
    {
#if USE_RGB_PWM
        if (sAppTask.mPwmRgbRedLed.IsTurnedOn() || sAppTask.mPwmRgbGreenLed.IsTurnedOn() || sAppTask.mPwmRgbBlueLed.IsTurnedOn())
        {
            action = PWMDevice::OFF_ACTION;
        }
        else
        {
            action = PWMDevice::ON_ACTION;
        }
#else
        // action = sAppTask.mPwmRgbBlueLed.IsTurnedOn() ? PWMDevice::OFF_ACTION : PWMDevice::ON_ACTION;
        dimmerAction = sAppTask.mDimmerDevice.IsTurnedOn() ? DeviceDimmer::OFF_ACTION : DeviceDimmer::ON_ACTION;
#endif
        dimmerActor = AppEvent::kEventType_Button;
    }

    if (dimmerAction != DeviceDimmer::INVALID_ACTION && !sAppTask.mDimmerDevice.InitiateAction(dimmerAction, dimmerActor, NULL))
//         (
// #if USE_RGB_PWM
//             !sAppTask.mPwmRgbRedLed.InitiateAction(action, actor, NULL) ||
//             !sAppTask.mPwmRgbGreenLed.InitiateAction(action, actor, NULL) ||
// #endif
//             !sAppTask.mPwmRgbBlueLed.InitiateAction(action, actor, NULL)))
    {
        LOG_INF("Action is in progress or active");
    }
#endif // CONFIG_WS2812_STRIP
}


void AppTask::ActionInitiated(DeviceDimmer::Action_t aAction, int32_t aActor)
{
    if (aAction == DeviceDimmer::ON_ACTION)
    {
        LOG_DBG("ON_ACTION initiated");
    }
    else if (aAction == DeviceDimmer::OFF_ACTION)
    {
        LOG_DBG("OFF_ACTION initiated");
    }
    else if (aAction == DeviceDimmer::LEVEL_ACTION)
    {
        LOG_DBG("LEVEL_ACTION initiated");
    }
}

void AppTask::ActionCompleted(DeviceDimmer::Action_t aAction, int32_t aActor)
{
    if (aAction == DeviceDimmer::ON_ACTION)
    {
        LOG_DBG("ON_ACTION completed");
    }
    else if (aAction == DeviceDimmer::OFF_ACTION)
    {
        LOG_DBG("OFF_ACTION completed");
    }
    else if (aAction == DeviceDimmer::LEVEL_ACTION)
    {
        LOG_DBG("LEVEL_ACTION completed");
    }

    if (aActor == AppEvent::kEventType_Button)
    {
        sAppTask.UpdateClusterState();
    }
}

void AppTask::UpdateClusterState(void)
{
    EmberAfStatus status;
    bool isTurnedOn;
    uint8_t setLevel;

#if defined(CONFIG_WS2812_STRIP) || USE_RGB_PWM
#ifdef CONFIG_WS2812_STRIP
    isTurnedOn = sAppTask.mWS2812Device.IsTurnedOn();
#else
    isTurnedOn =
        sAppTask.mPwmRgbRedLed.IsTurnedOn() || sAppTask.mPwmRgbGreenLed.IsTurnedOn() || sAppTask.mPwmRgbBlueLed.IsTurnedOn();
#endif // CONFIG_WS2812_STRIP

    if (sColorAction == PWMDevice::COLOR_ACTION_XY || sColorAction == PWMDevice::COLOR_ACTION_HSV ||
        sColorAction == PWMDevice::COLOR_ACTION_CT)
    {
        setLevel = sBrightness;
    }
    else
    {
#ifdef CONFIG_WS2812_STRIP
        setLevel = sAppTask.mWS2812Device.GetBlueLevel();
        if (setLevel > kDefaultMaxLevel)
        {
            setLevel = kDefaultMaxLevel;
        }
#else
        setLevel = sAppTask.mPwmRgbBlueLed.GetLevel();
#endif // CONFIG_WS2812_STRIP
    }
#else
    // isTurnedOn = sAppTask.mPwmRgbBlueLed.IsTurnedOn();
    // setLevel   = sAppTask.mPwmRgbBlueLed.GetLevel();
    isTurnedOn = sAppTask.mDimmerDevice.IsTurnedOn();
    setLevel   = sAppTask.mDimmerDevice.GetLevel();
#endif // CONFIG_WS2812_STRIP || USE_RGB_PWM

    // write the new on/off value
    status = Clusters::OnOff::Attributes::OnOff::Set(kExampleEndpointId, isTurnedOn);
    if (status != EMBER_ZCL_STATUS_SUCCESS)
    {
        LOG_ERR("Update OnOff fail: %x", status);
    }

    status = Clusters::LevelControl::Attributes::CurrentLevel::Set(kExampleEndpointId, setLevel);
    if (status != EMBER_ZCL_STATUS_SUCCESS)
    {
        LOG_ERR("Update CurrentLevel fail: %x", status);
    }
}

unsigned char AppTask::HandleOnOffValue(char channel, const unsigned char value[], unsigned short length)
{
    uint8_t ret = 0;
    using namespace Clusters;
    if (*value == 0x01)
    {
        ret = sAppTask.mDimmerDevice.UpdateFromHardware(DeviceDimmer::ON_ACTION, AppEvent::kEventType_Lighting, NULL);
        if(ret == 1)
        {
            Clusters::OnOff::Attributes::OnOff::Set(kExampleEndpointId, true);
        }
    }
    else if (*value == 0x00)
    {
        ret = sAppTask.mDimmerDevice.UpdateFromHardware(DeviceDimmer::OFF_ACTION, AppEvent::kEventType_Lighting, NULL);
        if(ret == 1)
        {
            Clusters::OnOff::Attributes::OnOff::Set(kExampleEndpointId, false);
        }
    }
    else
    {
        ret = 0;
    }

    return ret;
    
}

unsigned char AppTask::HandleBrightValue(char channel, const unsigned char value[], unsigned short length)
{
    uint8_t ret = 0;
    using namespace Clusters;
    uint8_t level;
    if(sAppTask.mDimmerDevice.GetType() == kTypeLight_LevelControl){
        level = (mcu_get_dp_download_value(value,length)*255)/1000;
        level = (level >= 255)? 254: level;
        ret = sAppTask.mDimmerDevice.UpdateFromHardware(DeviceDimmer::LEVEL_ACTION, AppEvent::kEventType_Lighting, &level);

        if(ret == 1)
        {
            if(level == 0 && sAppTask.mDimmerDevice.IsTurnedOn()){
                Clusters::OnOff::Attributes::OnOff::Set(kExampleEndpointId, false);
            }
            Clusters::LevelControl::Attributes::CurrentLevel::Set(kExampleEndpointId, level);
            
            // else if(level != 0 && !sAppTask.mDimmerDevice.IsTurnedOn()){
            //     Clusters::OnOff::Attributes::OnOff::Set(kExampleEndpointId, sAppTask.mDimmerDevice.IsTurnedOn());
            // }
        }
    } else if(sAppTask.mDimmerDevice.GetType() == kTypeLight_ColorControl){
        uint8_t level = (mcu_get_dp_download_value(value,length) * 255)/ sAppTask.mDimmerDevice.MAX_BRIGHTNESS_COLOR;
        level = (level >= 255)? 254: level;
        ret = sAppTask.mDimmerDevice.UpdateFromHardware(DeviceDimmer::LEVEL_ACTION, AppEvent::kEventType_Lighting, &level);
        if(ret == 1)
        {
            if(level == 0 && sAppTask.mDimmerDevice.IsTurnedOn()){
                Clusters::OnOff::Attributes::OnOff::Set(kExampleEndpointId, false);
            } 
            Clusters::LevelControl::Attributes::CurrentLevel::Set(kExampleEndpointId, level);
            // else if(sHSV.v != 0 && !sAppTask.mDimmerDevice.IsTurnedOn()){
            //     Clusters::OnOff::Attributes::OnOff::Set(kExampleEndpointId, sAppTask.mDimmerDevice.IsTurnedOn());
            // }
        }

    }
    // uart_send((uint8_t *) &level, 1);

    return ret;
    
}
// unsigned char AppTask::HandleMinBrightValue(char channel, const unsigned char value[], unsigned short length)
// {
// }

// unsigned char AppTask::HandleMaxBrightValue(char channel, const unsigned char value[], unsigned short length)
// {
// }


unsigned char AppTask::HandleHSL(char channel, const unsigned char value[], unsigned short length)
{
    uint8_t ret = 0;
    using namespace Clusters;
    if(sAppTask.mDimmerDevice.GetType() == kTypeLight_ColorControl) {
        uint16_t hue = (mcu_get_dp_download_value_2byte(value,length)* 255)/sAppTask.mDimmerDevice.MAX_BRIGHTNESS_COLOR;
        uint16_t saturation = (mcu_get_dp_download_value_2byte(value+2,length)* 255)/sAppTask.mDimmerDevice.MAX_BRIGHTNESS_COLOR;
        uint16_t lightness = (mcu_get_dp_download_value_2byte(value+4,length)* 255)/sAppTask.mDimmerDevice.MAX_BRIGHTNESS_COLOR;
        HsvColor_t hsv;
        hsv.h = (hue >= 255)? 254: hue;
        hsv.s = (saturation >= 255)? 254: saturation;
        hsv.v = (lightness >= 255)? 254: lightness;

        ret = sAppTask.mDimmerDevice.UpdateFromHardware(DeviceDimmer::COLOR_ACTION_HSV, AppEvent::kEventType_Lighting, (uint8_t*)&hsv);
        if(ret == 1)
        {
            if(hsv.v == 0 && sAppTask.mDimmerDevice.IsTurnedOn()){
                Clusters::OnOff::Attributes::OnOff::Set(kExampleEndpointId, false);
            }
            Clusters::LevelControl::Attributes::CurrentLevel::Set(kExampleEndpointId, hsv.v);

        }

    }
    return ret;
}

uint8_t AppTask::UpdateDevice(uint8_t dpid,const uint8_t value[], unsigned short length)
{
//	printf("dp_download_handle\n");
  /* only list of function, mcu need realize these fuction*/
	uint8_t ret = 0;
    uint8_t channel = 0;
    if(dpid == (DPID_SWITCH_LED_1 + channel*16)){
        ret = AppTask::HandleOnOffValue(channel,value,length);
        // print_uart("switch_led_handle\n");
        return ret;
    }
    else if(dpid ==  (DPID_BRIGHT_VALUE_1 + channel*16)){
        ret = AppTask::HandleBrightValue(channel,value,length);
        return ret;
    }
    else if(dpid == (DPID_BRIGHTNESS_MIN_1 + channel*16)){
        // ret = AppTask::HandleMinBrightValue(channel,value,length);
        return ret;
    }
    else if(dpid == (DPID_LED_TYPE_1 + channel*16)){
        // ret = dp_download_led_type_handle(channel,value,length);
        return ret;
    }
    else if(dpid == (DPID_BRIGHTNESS_MAX_1 + channel*16)){
        // ret = AppTask::HandleMaxBrightValue(channel,value,length);
        return ret;
    }
    else if(dpid == (DPID_TRANSACTION_1 +channel*16)){
        // ret = dp_download_transaction_time_handle(channel,value,length);
        return ret;
    }
    else if(dpid == (DPID_LIGHT_MODE_1 +channel*16)){
        // ret = dp_download_light_mode_handle(channel,value,length);
        return ret;
    }
    else if(dpid == (DPID_CCT_OR_HSL_1 +channel*16)){
        ret = AppTask::HandleHSL(channel,value,length);
        return ret;
    }
    else if(dpid == (DPID_LIGHTNESS_1 +channel*16)){
        // ret = dp_download_lightness_handle(channel,value,length);
        return ret;
    }
    else if(dpid == DPID_TERMP_OR_HUE_1 +channel*16){
        // ret = dp_download_termp_or_hue_handle(channel,value,length);
        return ret;
    }
    else if(dpid == (DPID_SATURATION_1 +channel*16)){
        // ret = dp_download_saturation_handle(channel,value,length);
        return ret;
    }

	if(dpid == (DPID_RESTART_STATUS )){
		// ret = dp_download_restart_status_handle(value,length);
	}

  return ret;
}


void AppTask::ControlCMD(fl_data_t data)
{
    uint8_t dp_id, index;
    uint8_t dp_type;
    uint8_t ret;
    uint8_t cmd_word = data.cmdword;
    unsigned short dp_len;

    dp_id = data.data[0];
    dp_type = data.data[1];
    dp_len = data.data[2] * 0x100;
    dp_len += data.data[3];
    switch(cmd_word)
	{
	case ZIGBEE_FACTORY_NEW_CMD:
        // mcu_reset_rf();
        chip::Server::GetInstance().ScheduleFactoryReset();
		break;
	case PRODUCT_INFO_CMD:
		get_product_info(&data);
		break;
	case ZIGBEE_STATE_CMD:
        mcu_dp_report_network(1, GetNetworkState());
		break;
	case ZIGBEE_CFG_CMD:
		// mcu_reset_rf();
		chip::Server::GetInstance().ScheduleFactoryReset();
		break;
	case ZIGBEE_DATA_REQ_CMD:
		break;
	case DATA_DATA_RES_CMD:
		break;
	case DATA_REPORT_CMD:
		index = get_dowmload_dpid_index(dp_id);

        if(dp_type != download_cmd[index].dp_type){
            return 0;
        }
        else {
            // TODO: check dp_len
            ret = AppTask::UpdateDevice(dp_id, &data.data[4], dp_len);
        }
        return ret;
		break;
	case RF_IBEACON_MESSAGE:
		break;
	default:
		break;
	}


}

void AppTask::HandleUartCallback(void)
{
    //check queue_data_rx, if have data, get and process it
    if(k_msgq_num_used_get(&queue_data_rx) == 0){
        return;
    }
    //get data from queue
    fl_data_t data;
    k_msgq_get(&queue_data_rx, &data, K_NO_WAIT);
    // TODO handle data
    ControlCMD(data);

    // uart_send((uint8_t*)&data, data.datalength[1] + 9);
    return ;
}

void AppTask::UpdateNumberDevice(void)
{
    //query product info
    rf_uart_write_frame(PRODUCT_INFO_CMD, 0);
}

void AppTask::SetNetworkState(uint8_t state)
{
    if(state != networkState){
        networkState = state;
        //report network state
        // mcu_dp_report_network(1, GetNetworkState());
    }
}

void AppTask::SetInitiateAction(DeviceDimmer::Action_t aAction, int32_t aActor, uint8_t * value)
{
#if defined(CONFIG_WS2812_STRIP) || USE_RGB_PWM
    bool setRgbAction = false;
    RgbColor_t rgb;
#endif // CONFIG_WS2812_STRIP || USE_RGB_PWM

    if (aAction == DeviceDimmer::ON_ACTION || aAction == DeviceDimmer::OFF_ACTION)
    {
#ifdef CONFIG_WS2812_STRIP
        if (aAction == PWMDevice::ON_ACTION)
        {
            sAppTask.mWS2812Device.Set(SET_RGB_TURN_ON);
        }
        else if (aAction == PWMDevice::OFF_ACTION)
        {
            sAppTask.mWS2812Device.Set(SET_RGB_TURN_OFF);
        }
#else
        // sAppTask.mPwmRgbBlueLed.InitiateAction(aAction, aActor, value);
        sAppTask.mDimmerDevice.InitiateAction(aAction, aActor, value);
#if USE_RGB_PWM
        sAppTask.mPwmRgbRedLed.InitiateAction(aAction, aActor, value);
        sAppTask.mPwmRgbGreenLed.InitiateAction(aAction, aActor, value);
#endif
#endif // CONFIG_WS2812_STRIP
    }
    else if (aAction == DeviceDimmer::LEVEL_ACTION)
    {
#if defined(CONFIG_WS2812_STRIP) || USE_RGB_PWM
        // Save a new brightness for ColorControl
        sBrightness = *value;

        if (sColorAction == PWMDevice::COLOR_ACTION_XY)
        {
            rgb = XYToRgb(sBrightness, sXY.x, sXY.y);
        }
        else if (sColorAction == PWMDevice::COLOR_ACTION_HSV)
        {
            sHSV.v = sBrightness;
            rgb    = HsvToRgb(sHSV);
        }
        else
        {
            memset(&rgb, sBrightness, sizeof(RgbColor_t));
        }

        ChipLogProgress(Zcl, "New brightness: %u | R: %u, G: %u, B: %u", sBrightness, rgb.r, rgb.g, rgb.b);
        setRgbAction = true;
#else
        // sAppTask.mPwmRgbBlueLed.InitiateAction(aAction, aActor, value);
        sAppTask.mDimmerDevice.InitiateAction(aAction, aActor, value);
#endif // CONFIG_WS2812_STRIP || USE_RGB_PWM
    }
    else if (aAction == DeviceDimmer::COLOR_ACTION_HSV)
    {
        if(sAppTask.mDimmerDevice.GetType() == kTypeLight_ColorControl)
        {
            sAppTask.mDimmerDevice.InitiateAction(aAction, aActor, value);
        }
    }
#if defined(CONFIG_WS2812_STRIP) || USE_RGB_PWM
    else if (aAction == PWMDevice::COLOR_ACTION_XY)
    {
        sXY = *reinterpret_cast<XyColor_t *>(value);
        rgb = XYToRgb(sBrightness, sXY.x, sXY.y);
        ChipLogProgress(Zcl, "XY to RGB: X: %u, Y: %u, Level: %u | R: %u, G: %u, B: %u", sXY.x, sXY.y, sBrightness, rgb.r, rgb.g,
                        rgb.b);
        setRgbAction = true;
        sColorAction = PWMDevice::COLOR_ACTION_XY;
    }
    else if (aAction == PWMDevice::COLOR_ACTION_HSV)
    {
        sHSV   = *reinterpret_cast<HsvColor_t *>(value);
        sHSV.v = sBrightness;
        rgb    = HsvToRgb(sHSV);
        ChipLogProgress(Zcl, "HSV to RGB: H: %u, S: %u, V: %u | R: %u, G: %u, B: %u", sHSV.h, sHSV.s, sHSV.v, rgb.r, rgb.g, rgb.b);
        setRgbAction = true;
        sColorAction = PWMDevice::COLOR_ACTION_HSV;
    }
    else if (aAction == PWMDevice::COLOR_ACTION_CT)
    {
        sCT = *reinterpret_cast<CtColor_t *>(value);
        if (sCT.ctMireds)
        {
            rgb = CTToRgb(sCT);
            ChipLogProgress(Zcl, "ColorTemp to RGB: CT: %u | R: %u, G: %u, B: %u", sCT.ctMireds, rgb.r, rgb.g, rgb.b);
            setRgbAction = true;
            sColorAction = PWMDevice::COLOR_ACTION_CT;
        }
    }

    if (setRgbAction)
    {
#ifdef CONFIG_WS2812_STRIP
        sAppTask.mWS2812Device.SetLevel(&rgb);
#else
        sAppTask.mPwmRgbRedLed.InitiateAction(aAction, aActor, &rgb.r);
        sAppTask.mPwmRgbGreenLed.InitiateAction(aAction, aActor, &rgb.g);
        sAppTask.mPwmRgbBlueLed.InitiateAction(aAction, aActor, &rgb.b);
#endif // CONFIG_WS2812_STRIP
    }
#endif // CONFIG_WS2812_STRIP || USE_RGB_PWM
}

#ifdef CONFIG_CHIP_ENABLE_POWER_ON_FACTORY_RESET
static constexpr uint32_t kPowerOnFactoryResetIndicationMax    = 4;
static constexpr uint32_t kPowerOnFactoryResetIndicationTimeMs = 1000;

unsigned int AppTask::sPowerOnFactoryResetTimerCnt;
k_timer AppTask::sPowerOnFactoryResetTimer;

void AppTask::PowerOnFactoryResetEventHandler(AppEvent * aEvent)
{
    LOG_INF("Lighting App Power On Factory Reset Handler");
    sPowerOnFactoryResetTimerCnt = 1;
#ifdef CONFIG_WS2812_STRIP
    sAppTask.mWS2812Device.Set(sPowerOnFactoryResetTimerCnt % 2);
#else
    sAppTask.mPwmRgbBlueLed.Set(sPowerOnFactoryResetTimerCnt % 2);
#if USE_RGB_PWM
    sAppTask.mPwmRgbRedLed.Set(sPowerOnFactoryResetTimerCnt % 2);
    sAppTask.mPwmRgbGreenLed.Set(sPowerOnFactoryResetTimerCnt % 2);
#endif
#endif // CONFIG_WS2812_STRIP
    k_timer_init(&sPowerOnFactoryResetTimer, PowerOnFactoryResetTimerEvent, nullptr);
    k_timer_start(&sPowerOnFactoryResetTimer, K_MSEC(kPowerOnFactoryResetIndicationTimeMs),
                  K_MSEC(kPowerOnFactoryResetIndicationTimeMs));
}

void AppTask::PowerOnFactoryResetTimerEvent(struct k_timer * timer)
{
    sPowerOnFactoryResetTimerCnt++;
    LOG_INF("Lighting App Power On Factory Reset Handler %u", sPowerOnFactoryResetTimerCnt);
#ifdef CONFIG_WS2812_STRIP
    sAppTask.mWS2812Device.Set(sPowerOnFactoryResetTimerCnt % 2);
#else
    sAppTask.mPwmRgbBlueLed.Set(sPowerOnFactoryResetTimerCnt % 2);
#if USE_RGB_PWM
    sAppTask.mPwmRgbRedLed.Set(sPowerOnFactoryResetTimerCnt % 2);
    sAppTask.mPwmRgbGreenLed.Set(sPowerOnFactoryResetTimerCnt % 2);
#endif
#endif // CONFIG_WS2812_STRIP
    if (sPowerOnFactoryResetTimerCnt > kPowerOnFactoryResetIndicationMax)
    {
        k_timer_stop(timer);
        LOG_INF("schedule factory reset");
        chip::Server::GetInstance().ScheduleFactoryReset();
    }
}
#endif /* CONFIG_CHIP_ENABLE_POWER_ON_FACTORY_RESET */
```

## src/DeviceDimmer.cpp
```c
/*
 *
 *    Copyright (c) 2023 Project CHIP Authors
 *
 *    Licensed under the Apache License, Version 2.0 (the "License");
 *    you may not use this file except in compliance with the License.
 *    You may obtain a copy of the License at
 *
 *        http://www.apache.org/licenses/LICENSE-2.0
 *
 *    Unless required by applicable law or agreed to in writing, software
 *    distributed under the License is distributed on an "AS IS" BASIS,
 *    WITHOUT WARRANTIES OR CONDITIONS OF ANY KIND, either express or implied.
 *    See the License for the specific language governing permissions and
 *    limitations under the License.
 */

#include "DeviceDimmer.h"

#include "UartService.h"
#include "libuser.h"
#include <app-common/zap-generated/attributes/Accessors.h>

#include <cstdio>
// #include <lib/support/CHIPMemString.h>
// #include <platform/CHIPDeviceLayer.h>
// #include <app/server/Server.h>
#include "AppTask.h"


using namespace ::chip::Platform;
using namespace ::chip::DeviceLayer;
using namespace ::chip::app::Clusters;

extern ProductInfo_t product_info;
// uint8_t kExampleEndpointId = 1;

LOG_MODULE_DECLARE(app, CONFIG_CHIP_APP_LOG_LEVEL);

CHIP_ERROR DeviceDimmer::Init(const char * szDeviceName, const char * szLocation, uint8_t level, uint8_t min, uint8_t max)
{
    //check product id
    if(product_info.product_id[3] == 's')
    {
        mState = kState_Off;
        mType = kTypeLight_OnOff;

    }
    else if(product_info.product_id[3] == 'd')
    {
        mType = kTypeLight_LevelControl;
        mState = kState_Off;
        mLevel = level;
        mMinLevel = min;
        mMaxLevel = max;
        // print_uart("Init dimmer");
    }
    else if(product_info.product_id[3] == 'r')
    {
        mType = kTypeLight_ColorControl;
        mState = kState_Off;
        mLevel = level;
        mMinLevel = min;
        mMaxLevel = max;
        mHsvColor.h = 0;
        mHsvColor.s = 0;
        mHsvColor.v = 0;
        // print_uart("Init RGB");
    }
    else
    {
        mType = kTypeLight_ColorControl;
        mState = kState_Off;
        mLevel = level;
        mMinLevel = min;
        mMaxLevel = max;
        mHsvColor.h = 0;
        mHsvColor.s = 0;
        mHsvColor.v = 0;
        // print_uart("default init");
    }


    CopyString(mName, sizeof(mName), szDeviceName);
    CopyString(mLocation, sizeof(mLocation), szLocation);

    ClearAction();
    Set(false);

    return CHIP_NO_ERROR;

}

void DeviceDimmer::Set(bool aOn)
{
    if (aOn)
    {
        mState = kState_On;
        ChipLogProgress(Zcl, "Turn on LED");
    }
    else
    {
        mState = kState_Off;
        ChipLogProgress(Zcl, "Turn off LED");
    }
}

void DeviceDimmer::SetLevel(uint8_t aLevel)
{
    mLevel = aLevel;
    if(mType == kTypeLight_ColorControl)
    {
        mHsvColor.v = aLevel;
    }

}

void DeviceDimmer::SetHSVColor(uint8_t hue, uint8_t saturation)
{
    mHsvColor.h = hue;
    mHsvColor.s = saturation;
    ChipLogProgress(Zcl, "Set LED color to %u, %u", hue, saturation);
}

void DeviceDimmer::SetCCTColor(uint16_t colorTemperature)
{
    mCCTColor.colorTemperature = colorTemperature;
    ChipLogProgress(Zcl, "Set LED CCT color to %u", colorTemperature);
}

void DeviceDimmer::ClearAction(void)
{
    mLevel = 0;
}
bool DeviceDimmer::InitiateAction(Action_t aAction, int32_t aActor, uint8_t * value)
{
    bool action_initiated = false;
    State_t new_state;

    // Initiate On/Off Action only when the previous one is complete.
    if (mState == kState_Off && aAction == ON_ACTION)
    {
        action_initiated = true;
        new_state        = kState_On;
    }
    else if (mState == kState_On && aAction == OFF_ACTION)
    {
        action_initiated = true;
        new_state        = kState_Off;
    }
    else if ((aAction == LEVEL_ACTION || aAction == COLOR_ACTION_HSV)&& value[0] != mLevel)
    {
        action_initiated = true;
        if (value[0] == 0)
        {
            new_state = kState_Off;
        }
        else
        {
            new_state = kState_On;
        }
    }

    if (action_initiated)
    {
        if (aAction == ON_ACTION || aAction == OFF_ACTION)
        {
            Set(new_state == kState_On);
            int DPID_SWITCH_1 = DPID_SWITCH_LED_1;
            mcu_dp_bool_update(DPID_SWITCH_1, IsTurnedOn());
        }
        else if (aAction == LEVEL_ACTION )
        {
            if(mType == kTypeLight_LevelControl)
            {
                SetLevel(value[0]);
                int DPID_BRIGHT_VALUE = DPID_BRIGHT_VALUE_1;
                unsigned long level = this->GetLevel()*1000/254;
                mcu_dp_value_update(DPID_BRIGHT_VALUE, level);
            }
            else if(mType == kTypeLight_ColorControl)
            {
                SetLevel(value[0]);
                int DPID_COLOR_HSV_1 = DPID_BRIGHT_VALUE_1;
                unsigned long level = (this->GetHSVColor().v*MAX_BRIGHTNESS_COLOR)/254;
                mcu_dp_value_update(DPID_COLOR_HSV_1, level);
            }
            
        }
        else if (aAction == COLOR_ACTION_HSV && mType == kTypeLight_ColorControl)
        {
            SetHSVColor(value[0], value[1]);
            uint16_t hue = (this->GetHSVColor().h*MAX_BRIGHTNESS_COLOR)/254;
            uint16_t saturation = (this->GetHSVColor().s*MAX_BRIGHTNESS_COLOR)/254;
            uint16_t lightness = (this->GetHSVColor().v*MAX_BRIGHTNESS_COLOR)/254;
            int DPI_COLOR_HSV_1 = DPID_CCT_OR_HSL_1;
            mcu_dp_hsl_value_update(DPI_COLOR_HSV_1, hue, saturation, lightness);
        }

    }
    return action_initiated;

}
bool DeviceDimmer::UpdateFromHardware(Action_t aAction, int32_t aActor, uint8_t * value)
{
    bool action_initiated = false;
    switch (aAction)
    {
    case ON_ACTION:
        if(mState == kState_On)
        {
            return false;
        }
        Set(true);
        action_initiated = true;
        break;
    case OFF_ACTION:
        if(mState == kState_Off)
        {
            return false;
        }
        Set(false);
        action_initiated = true;
        break;
    case LEVEL_ACTION:
        if(mType == kTypeLight_LevelControl)
        {
            if(value[0] == this->GetLevel())
            {
                return false;
            }
            this->SetLevel(value[0]);
            if(value[0] == 0 && mState == kState_On)
            {
                this->Set(false);
            }
            else if(value[0] != 0 && mState == kState_Off)
            {
                this->Set(true);
            }
            action_initiated = true;
        }
        else if(mType == kTypeLight_ColorControl)
        {
            uint8_t level = value[0];
            if(level == this->GetHSVColor().v)
            {
                return false;
            }
            this->SetLevel(level);
            if(level == 0 && mState == kState_On)
            {
                this->Set(false);
            }
            else if(level != 0 && mState == kState_Off)
            {
                this->Set(true);
            }
            action_initiated = true;
        }
        break;

    case COLOR_ACTION_HSV:
        if(mType == kTypeLight_ColorControl)
        {
            uint8_t hue = value[0];
            uint8_t saturation = value[1];
            uint8_t level = value[2];
            // if(hue == this->GetHSVColor().h && saturation == this->GetHSVColor().s && level == this->GetHSVColor().v)
            // {
            //     return false;
            // }
            if(level == this->GetHSVColor().v)
            {
                return false;
            }
            this->SetLevel(level);
            if(level == 0 && mState == kState_On)
            {
                this->Set(false);
            }
            else if(level != 0 && mState == kState_Off)
            {
                this->Set(true);
            }
            action_initiated = true;
            // this->SetHSVColor(hue, saturation);
        }
        break;
    default:
        break;
    }

    return action_initiated;
}
void DeviceDimmer::StopAction(void)
{
    ClearAction();
    Set(false);
}

void DeviceDimmer::UpdateAction(void)
{
    // switch (mAction)
    // {
    // case ON_ACTION:
    //     Set(true);
    //     break;

    // case OFF_ACTION:
    //     Set(false);
    //     break;

    // case LEVEL_ACTION:
    //     SetLevel(*mValue);
    //     break;

    // default:
    //     break;
    // }

    // ClearAction();
}

// void DeviceDimmer::SetCallbacks(DimmerCallback_fn aActionInitiated_CB, DimmerCallback_fn aActionCompleted_CB,
//                                 DimmerTimerCallback_fn aActionBlinkStateUpdate_CB)
// {
//     mActionInitiatedClb = aActionInitiated_CB;
//     mActionCompletedClb = aActionCompleted_CB;
//     mActionBlinkStateUpdateClb = aActionBlinkStateUpdate_CB;
// }

// void DeviceDimmer::ActionInitiated(Action_t aAction, int32_t aActor)
// {
//     if (mActionInitiatedClb != nullptr)
//     {
//         mActionInitiatedClb(aAction, aActor);
//     }
// }

// void DeviceDimmer::ActionCompleted(Action_t aAction, int32_t aActor)
// {
//     if (mActionCompletedClb != nullptr)
//     {
//         mActionCompletedClb(aAction, aActor);
//     }
// }

// void DeviceDimmer::ActionBlinkStateUpdate(k_timer * dummy)
// {
//     if (mActionBlinkStateUpdateClb != nullptr)
//     {
//         mActionBlinkStateUpdateClb(dummy);
//     }
// }

// void DeviceDimmer::InitiateBlinkAction(uint32_t onTimeMS, uint32_t offTimeMS)
// {
//     mBlinkOnTimeMS = onTimeMS;
//     mBlinkOffTimeMS = offTimeMS;
//     mBlinkState = true;
//     mBlinkTimer = k_timer_create(&mBlinkTimer, (k_timer_expiry_t) ActionBlinkStateUpdate, nullptr);
//     k_timer_start(&mBlinkTimer, K_MSEC(mBlinkOnTimeMS), K_MSEC(mBlinkOnTimeMS));
// }
```
